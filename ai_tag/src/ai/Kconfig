## ai_tag/src/ai/Kconfig
```kconfig
menuconfig AI_ANALYSIS
	bool "AI Analysis Functions"

if AI_ANALYSIS

module = AI_ANALYSIS
module-str = AI Analysis
source "subsys/logging/Kconfig.template.log_config"

endif # AI_ANALYSIS
```

## ai_tag/src/cloud/coap_handler/Kconfig
```kconfig
# Copyright (c) 2023 Nordic Semiconductor
#
# SPDX-License-Identifier: LicenseRef-Nordic-5-Clause
#

menuconfig COAP_HELPER
	bool "CoAp helper library"
	help
	  Convenience library that simplifies Zephyr COAP API and socket handling.

if COAP_HELPER

config COAP_HELPER_PORT
	int "COAP broker port"
	default 5683
	help
	  Port number to connect to the COAP broker.

config COAP_HELPER_SEND_TIMEOUT
	bool "Send data with socket timeout"
	default y
	help
	  Configures a timeout on the COAP socket to ensure that a call to the send
	  function will not block indefinitely. To configure the length of the timeout,
	  use COAP_HELPER_SEND_TIMEOUT_SEC.

config COAP_HELPER_SEND_TIMEOUT_SEC
	int "Send timeout"
	depends on COAP_HELPER_SEND_TIMEOUT
	default 60
	help
	  Timeout in seconds to use when the COAP socket is configured to
	  send with a timeout by enabling COAP_HELPER_SEND_TIMEOUT.

config COAP_HELPER_STATIC_IP_ADDRESS
	string "Static IP address"
	help
	  Set a static IP address to use when connecting to the COAP broker.
	  Leave the string empty to use DNS to resolve the IoT Hub hostname instead.

config COAP_HELPER_STACK_SIZE
	int "Connection thread stack size"
	default 2560
	help
	  The stack size of the internal thread in the library.
	  The thread polls the COAP socket while it's open.
	  All COAP-related callbacks happen in context of this thread, so the stack size may have
	  to be adjusted for your needs.

config COAP_HELPER_TX_BUFFER_SIZE
	int "Buffer sizes for the COAP library"
	default 512
	help
	  Specifies maximum message size can be transmitted through
	  COAP.

config COAP_HELPER_RX_BUFFER_SIZE
	int "Buffer sizes for the COAP library"
	default 512
	help
	  Specifies maximum message size can be received through
	  COAP.

module = COAP_HELPER
module-str = COAP helper library
source "${ZEPHYR_BASE}/subsys/logging/Kconfig.template.log_config"

endif # COAP_HELPER
```

## ai_tag/src/cloud/thingsboard_iot/Kconfig
```kconfig
#
# Copyright (c) 2020 Nordic Semiconductor
#
# SPDX-License-Identifier: LicenseRef-Nordic-5-Clause
#

module = THINGSBOARD_IOT
module-prompt = "Thingsboard IoT"
orsource "../Kconfig.cloud_$(CLOUD_SERVICE_SELECTOR)"

menuconfig $(module)
	bool
	prompt "Thingsboard IoT"

if THINGSBOARD_IOT

config THINGSBOARD_IOT_HOSTNAME
	string "Thingsboard IoT hostname"
	help
	  Hostname to Thingsboard IoT instance.

config THINGSBOARD_IOT_DEVICE_ID_MAX_LEN
	int "Maximum length of device id"
	default 30
	help
	  Maximum length for device provision secret

config THINGSBOARD_IOT_DEVICE_TOKEN
	string "Thingsboard IoT device token"
	help
	  Thingsboard IoT device token.

config THINGSBOARD_IOT_DEVICE_TOKEN_MAX_LEN
	int "Maximum length of device token"
	default 30
	help
	   Maximum length for device token.

config THINGSBOARD_IOT_DEVICE_PROVISION_KEY
	string "Thingsboard IoT provision key"
	help
	  Thingsboard IoT provision secret. Define only if
	  device token is not defined.

config THINGSBOARD_IOT_DEVICE_PROVISION_KEY_MAX_LEN
	int "Maximum length of device provision key"
	default 30
	help
	   Maximum size for device provision key

config THINGSBOARD_IOT_DEVICE_PROVISION_SECRET
	string "Thingsboard IoT provision secret"
	help
	  Thingsboard IoT provision secret. Define only if
	  device token is not defined.

config THINGSBOARD_IOT_DEVICE_PROVISION_SECRET_MAX_LEN
	int "Maximum length of device provision secret"
	default 30
	help	
	   Maximum length for device provision secret

config THINGSBOARD_IOT_COAP_URI_PATH_MAX_LEN
	int "Maximum length of coap uri path"
	default 50
	help
	  Here is an example uri path for the coap,
	  "/api/v1/{device_token}/telemetry" 

module=THINGSBOARD_IOT
module-dep=LOG
module-str=Thingsboard IoT
source "${ZEPHYR_BASE}/subsys/logging/Kconfig.template.log_config"

endif # THINGSBOARD_IOT
```

## ai_tag/src/modules/Kconfig.ai_module
```kconfig
#
# Copyright (c) 2021 Nordic Semiconductor
#
# SPDX-License-Identifier: LicenseRef-Nordic-5-Clause
#

menuconfig AI_MODULE
	bool "AI module"
	select EXTERNAL_SENSORS if BOARD_THINGY91_NRF9160_NS
	default y

if AI_MODULE

config AI_THREAD_STACK_SIZE
	int "AI module thread stack size"
	default 4096 if EXTERNAL_SENSORS_BME680_BSEC
	default 1280

endif # AI_MODULE

module = AI_MODULE
module-str = AI module
source "subsys/logging/Kconfig.template.log_config"
```
